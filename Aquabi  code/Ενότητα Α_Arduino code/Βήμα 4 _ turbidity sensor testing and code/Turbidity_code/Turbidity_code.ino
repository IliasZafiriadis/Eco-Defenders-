#define power 13  //Θέτω όπου εμφανίζεται power την τιμή 13 
#define sensor2 A2  //Θέτω όπου εμφανίζεται sensor2 την τιμή Α2 (Θολερότητα)
//Δεδομένα
bool send_Command = false;  //Πληροφορεί αν έχει σταλλεί εντολή από το android  για να στείλει τις μετρήσεις από τους αισθητήρες
float sensorData2;  //Μετρήσεις από τον αισθητήρα θολερότητας

void setup() {
  Serial.begin(9600); //Εκκίνηση επικοινωνίας μεσώ του bluetooth, των αισθητήρων και του monitor
  digitalWrite(power, LOW); //Μηδενίζω  , αρχικά, την τάση που λαμβάνουν οι αισθητήρες
  //Ορίζω αυτά τα pin ως εξόδους
  pinMode(power, OUTPUT);
}

void loop() {
if (send_Command) { //Αν έχει ληφθεί εντολή αποστολής δεδομένων, 
    digitalWrite(power, HIGH);  //Ανοίγω την τάση για τους αισθητήρες,
    delay(40);  //Περιμένω 40 χιλιοστά του δευτερολέπτου,
    get_sensorData_Raw_And_Send_Phone();  //Παίρνω  τις μετρήσεις από τους αισθητήρες θερμοκρασίας, θολερότητας και turbidity
    delay(10);  //Περιμένω  10 χιλιοστά του δευτερολέπτου
    digitalWrite(power, LOW);   } //Μηδενίζω  την τάση.
    delay(100);  }  //Περιμένω 1/10 του λεπτού
}
void get_sensorData_Raw_And_Send_Phone() {  //============Διαδικασία για την απολαβή των μετρήσεων και την αποστολή τους στη συσκευή android============
    /*Παίρνω 5 συνεχόμενες μετρήσεις (με 10 χιλιοστά του δευτερολέπτου διαφορά) από τον αισθητήρα θολερότητας,
    τις αθροίζω, στην μεταβλητή sensorData2 και βγάζω τον μέσο όρο. 
    Όσο ο μέσος όρος δεν είναι αριθμός (δηλαδή έγινε σφάλμα), 
    επαναλαμβάνω αυτή τη διαδικασία.*/
  do  { 
    sensorData2 = 0;  
    for (int i = 1; i <= 10; i++) { 
      sensorData2 = sensorData2 + analogRead(sensor2);  
      delay(50);  } 
    sensorData2 = sensorData2 / 10.0; 
  } while (isnan(sensorData2)); 
  
  delay(500);   //Περιμένω μισό δευτερόλεπτο.
  sensorData2 = sensorData2 * (5.0 / 1024.0) + 2000.0; //Ορίζω ως μονάδα μέτρησης της θελερότητας το 1V (volt) και προσθέτω 2000, ώστε να αλλάξει το πεδίο ορισμού του αισθητήρα με στόχο, το πρόγραμμα android να την ξεχωρίζει.
    
  Serial.print(" !--> "); Serial.println (sensorData2-2000.0);  //Πρόβαλλω την μέτρηση από τον αισθητήρα θολερότητας στο monitor.
  delay(500); //Περιμένω μισό δευτερόλεπτο.
} 
