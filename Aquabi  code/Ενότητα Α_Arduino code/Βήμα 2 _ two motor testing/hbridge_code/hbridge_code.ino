//Δεδομένα
int RecievedValue2 = 0; //Η τιμή που αντιστοιχεί στο joystick_x 
int RecievedValue3 = 0; //Η τιμή που αντιστοιχεί στο joytick_y

//Κινητήρες
int enA = 6;  //Έξοδος για την ταχύτητα του αριστερού κινητήρα
//Μεταβλητές που καθορίζουν την φορά του αριστερού κινητήρα
int in1 = 7;  
int in2 = 5;  
//motorB connections  
int enB = 3;  //Έξοδος για την ταχύτητα του δεξιού κινητήρα
//Μεταβλητές που καθορίζουν την φορά του αριστερού κινητήρα
int in3 = 2; 
int in4 = 4;  
int Speed;  //Μέγιστη ταχύτητα η οποία θα μοιραστεί στους δύο κινητήρες

void setup() {
  Serial.begin(9600); //Εκκίνηση επικοινωνίας μεσώ του bluetooth, των αισθητήρων και του monitor
  //Ορίζω αυτά τα pin ως εξόδους
  pinMode(enA, OUTPUT); 
  pinMode(enB, OUTPUT); 
  pinMode(in1, OUTPUT); 
  pinMode(in2, OUTPUT); 
  pinMode(in3, OUTPUT); 
  pinMode(in4, OUTPUT); 
}

void loop() {
  send_ControllerData_SpeedControllers(); //Στέλνω τα δεδομένα για τους κινητήρες, στους κινητήρες
  delay(100);  }  //Περιμένω 1/10 του λεπτού

void send_ControllerData_SpeedControllers() {   //============Διαδικασία για τη κίνηση των κινητήρων============
  int motorA; //Τιμή ταχύτητας αριστερού κινητήρα.  
  int motorB; //Τιμή ταχύτητα δεξιού κινητήρα.
  boolean rotation; //Αν η κίνηση γίνεται προς τα πίσω(false) ή προς τα μπροστά(true).
  
  if (isnan(RecievedValue2)) {  //Αν η η τιμή δεν είναι αριθμός (δηλαδή, έχει γίνει κάποιο σφάλμα),
    RecievedValue2 = 0; //Την θέτω 0
  } 
  if (isnan(RecievedValue3)) {  //Αν η η τιμή δεν είναι αριθμός (δηλαδή, έχει γίνει κάποιο σφάλμα),
    RecievedValue3 = 0; //Την θέτω 0
  } 
  
  if (RecievedValue3 <= 0) {  //Αν το joystick_y είναι μη θετικός αριθμός,
    Speed = RecievedValue3 * (-1);  //θέτω την γενική ταχύτητα με τον αντίθετό του,
     //ρυθμίζω τους κινητήρες έτσι ώστε να κινούν το όχημα προς τα πίσω και
    digitalWrite(in1, HIGH); 
    digitalWrite(in2, LOW); 
    digitalWrite(in3, HIGH);  
    digitalWrite(in4, LOW); 
    rotation = false; //Ορίζω πως η κίνηση γίνεται προς τα πίσω.
  } 
  if (RecievedValue3 > 0) { //Αν το joystick_y είναι θετικός αριθμός,
    Speed = RecievedValue3; //θέτω την γενική ταχύτητα ίση με αυτόν,
    //ρυθμίζω τους κινητήρες έτσι ώστε να κινούν το όχημα προς τα μπροστά και
    digitalWrite(in1, LOW); 
    digitalWrite(in2, HIGH);  
    digitalWrite(in3, LOW); 
    digitalWrite(in4, HIGH);  
    rotation = true;  //ορίζω πως η κίνηση γίνεται προς τα μπροστά.
  } 
  
  if (RecievedValue2 >= 128) {  //Αν το joystick_x είναι ίσο ή μεγαλύτερο του μισού του περίου ορισμού του (128), τότε
    motorA = map ( 128 * Speed , 0 , 128 * 255 /*32640*/, 0 , 255); //Θέτω την ταχύτητα του αριστερού κινητήρα με ποσοστό διανομής 100% της γενικής ταχύτητας και την το αντιστοιχώ σε πεδίο τιμών από 0 μέχρι 255. 
  } 
  else if (RecievedValue2 < 128) {  //Αλλιώς, αν το joystick_x είναι μικρότερο από το μισό του πεδίου ορισμού του (128), τότε
    motorA = map ( RecievedValue2 * Speed , 0 , 128 * 255 /*32640*/ , 0 , 255); //Θέτω την ταχύτητα του αριστερού κινητήρα με ποσοστό διανομής που ορίζει η ReceivedValue2 της γενικής ταχύτητας και την αντιστοιχώ σε πεδίο τιμών από 0 μέχρι 255. 
  } 
  if (255 - RecievedValue2 >= 128) {  //Αν το υπόλοιπο του joystick_x είναι ίσο ή μεγαλύτερο του μισού του περίου ορισμού του (128), τότε
    motorB = map ( 128 * Speed , 0 , 128 * 255 /*32640*/ , 0 , 255);  //Θέτω την ταχύτητα του αριστερού κινητήρα με ποσοστό διανομής 100% της γενικής ταχύτητας και την το αντιστοιχώ σε πεδίο τιμών από 0 μέχρι 255. 
  } 
  else if (255 - RecievedValue2 < 128) {  //Αλλιώς, αν το υπόλοιπο του joystick_x είναι μικρότερο από το μισό του πεδίου ορισμού του (128), τότε
    motorB = map ( (255 - RecievedValue2) * Speed , 0 , 128 * 255 /*32640*/ , 0 , 255); //Θέτω την ταχύτητα του αριστερού κινητήρα με το υπόλοιπο ποσοστό διανομής που ορίζει η ReceivedValue2 της γενικής ταχύτητας και την αντιστοιχώ σε πεδίο τιμών από 0 μέχρι 255. 
  } 
  analogWrite(enA, motorA); //Στέλνω την ταχύτητα του αριστερού κινητήρα στην έξοδο για τον αριστερό κινητήρα.
  analogWrite(enB, motorB); //Στέλνω την ταχύτητα του δεξιού κινητήρα στην έξοδο για τον δεξιό κινητήρα.
  
  /*Προβάλλω στο monitor, την ταχύτητα του κάθε κινητήρα και αν κινούνται προς τα μπροστά ή προς τα πίσω
  (κάτι που αρχικά πρέπει να ορίσω εγώ, όταν συνδέω τα καλώδια των κινητήρων στην πλακέτα).*/
  Serial.print(motorA); Serial.print(" A ||  ");   
  Serial.print(motorB); Serial.print(" B | "); 
  if (!rotation) {  
    Serial.println("Backwards");  
  } else if (rotation) {  
    Serial.println("Forward");  
  } 
} 
