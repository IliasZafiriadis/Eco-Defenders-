#include <SoftwareSerial.h>   //Βιβλιοθήκη για την μεταφορά δεδομένων μέσω BT.
//Ορίζω αντικείμενα και τις ιδιότητές τους, ώστε να μπορέσω να αξιοποιήσω τις παραπάνω βιβλιοθήκες
SoftwareSerial Arduino(9, 10); 

//Δεδομένα
String answer;  //To σύνολο των απεσταλμένων δεδομένων
bool send_Command = false;  //Πληροφορεί αν έχει σταλλεί εντολή από το android  για να στείλει τις μετρήσεις από τους αισθητήρες
int data; //To μετατροπή του συνόλου δεδομένων σε αριθμό για πράξεις
int RecievedValue2 = 0; //Η τιμή που αντιστοιχεί στο joystick_x 
int RecievedValue3 = 0; //Η τιμή που αντιστοιχεί στο joytick_y

void setup() {
  Serial.begin(9600); //Εκκίνηση επικοινωνίας μεσώ του bluetooth, των αισθητήρων και του monitor
  Arduino.begin(9600);  

}

void loop() {
  get_SpeedDataAndCommands_Phone ();  //Διαδικασία η οποία λαμβάνει και αναγωνρίζει τα δεδομένα για τους κινητήρες και τις εντολές
  delay(100);   //Περιμένω 1/10 του λεπτού
}

void get_SpeedDataAndCommands_Phone () {  //Διαδικασία για την απολαβή δεδομένων από τη συσκευή android
  while (Arduino.available()) { //Όσο ανιχνεύω εισερχόμενα δεδομένα,
    delay(10);  //Περιμένω 10 χιλιοστά του δευτερολέπτου
    if (Arduino.available() > 0) {  //Αν τα δεδομένα αντοιστιχούν σε κάποιο χαρακτήρα
      answer += char( Arduino.read());  //Προσθέτω τον χαρακτήρα στην μεταβλητή για να φτιάξω μία λέξη
      //Serial.print(answer); //Προβάλλω στο monitor την λέξη
    } 
  } 
  
  if (answer != "") { //Αν η λέξη που έφτιαξα έχει περιεχόμενο,
    data = answer.toInt();  //Μετατρέπω την λέξη αυτή σε αριθμό (εφόσον γνωρίζω πως αυτό που λαμβάνω θα είναι πάντα στη μορφή αριθμού)
    //Serial.println(data); //Προβάλλω στο monitor τον αριθμό
  
    if (data == 5) {  //Αν ο αριθμός ισούται με 5, σημαίνει πως ο χρήστης τεστάρει την επικοινωνία, οπότε
      Arduino.println("fine");  //Serial.println("Fine!");  //προβάλλω στο monitor την λέξη «Fine» και στέλνω στο arduino την λέξη «fine».
    } 
    delay(20);  //Περιμένω 20 χιλιοστά του δευτερολέπτου
    if (data == 1000) { //Αν ο αριθμός ισούται με 1000, σημαίνει πως πρέπει να στείλω τις μετρήσεις από τους αισθητήρες, οπότε
      send_Command = true; // το σηματοδοτώ ρυθμίζοντας την μεταβλητή send_Command 
      //Serial.print(send_Command); //Προβάλλω στο monitor τον αριθμό που αποτελεί την εντολή send_command, «1000».
      Serial.println("ok"); //Προβάλλω στο monitor τη λέξη «ok»
      Arduino.println("ok");  //Στέλνω στο arduino την λέξη «ok».
    } 
    else {  //Αλλιώς, σημαίνει πως δεν χρειάζεται να στείλω τις μετρήσεις από τους αισθητήρες, οπότε 
      send_Command = false; //το σηματοδοτώ ρυθμίζοντας την μεταβλητή send_Command 
      //Serial.println("nope"); //προβάλλω τη λέξη «nope»
      delay(10);  //και περιμένω 10 χιλιοστά του δευτερολέπτου.
    } 
  
     if (data >= 2000 && data <= 2255) {  //Αν ο αριθμός είναι μεταξύ του 2000 και του 2255, σημαίνει πως είναι η μεταβλητή που αντιστοιχεί στο joystick_x στη συσκευή android, όμως χρειάζεται πρώτα αποκωδικοποίηση, επομένως
      RecievedValue2 = data - 2000; //αφαιρώ 2000 από την τιμή,
      delay(20);  //και περιμένω 20 χιλιοστά του δευτερολέπτου.
    } 
  
    else if (data >= 3000 && data <= 3510) {  //Αλλιώς, αν η τιμή είναι μεταξύ του 3000 και του 3510, σημαίνει πως είναι η μεταβλητή που αντιστοιχεί στο joystick_y στη συσκευή android, όμως χρειάζεται πρώτα αποκωδικοποίηση, επομένως
      RecievedValue3 = data - 3255; //αφαιρώ το 3255 (ώστε να θέσω μηδενική τιμή, το //μέσο αυτού του πεδίου)
      delay(20);  //και περιμένω 20 χιλιοστά του δευτερολέπτου.
    } 
    answer = "";  //Σβήνω την απάντηση
  } 
} 
